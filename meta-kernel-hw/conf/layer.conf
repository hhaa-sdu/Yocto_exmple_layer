## meta-kernel-hw/conf/layer.conf
```bitbake
# We have a conf and classes directory, add to BBPATH
BBPATH .= ":${LAYERDIR}"

# We have recipes-* directories, add to BBFILES
BBFILES += "${LAYERDIR}/recipes-*/*/*.bb \
            ${LAYERDIR}/recipes-*/*/*.bbappend"

BBFILE_COLLECTIONS += "meta-kernel-hw"
BBFILE_PATTERN_meta-kernel-hw = "^${LAYERDIR}/"
BBFILE_PRIORITY_meta-kernel-hw = "6"

LAYERDEPENDS_meta-kernel-hw = "core"
LAYERSERIES_COMPAT_meta-kernel-hw = "thud"
```
